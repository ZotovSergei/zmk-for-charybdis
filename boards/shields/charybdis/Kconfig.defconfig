## boards/shields/charybdis/Kconfig.defconfig
```kconfig
if CONFIG_SHIELD_CHARYBDIS_DONGLE

config ZMK_KEYBOARD_NAME
	default "Charybdis"

config ZMK_SPLIT_ROLE_CENTRAL
	default y

endif

if CONFIG_SHIELD_CHARYBDIS_DONGLE || CONFIG_SHIELD_CHARYBDIS_LEFT || CONFIG_SHIELD_CHARYBDIS_RIGHT

config ZMK_SPLIT
	default y

endif
```
